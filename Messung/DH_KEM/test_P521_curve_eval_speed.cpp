#include <Crypto.h>
#include <P521.h>
#include <SHA512.h>
#include <RNG.h>
#include <string.h>
#include <avr/pgmspace.h>
#include "print.h"
#include "avr.h"
#include "cpucycles.h"

static uint8_t alice_k[132];
static uint8_t alice_f[66];
static uint8_t bob_k[132];
static uint8_t bob_f[66];

void testEval();
int main(int argc, char const *argv[])
{
    testEval();
    avr_end();
    return 0;
}

static int P521_memcmp_P(const void *s1, const void *s2, size_t len)
{
    const uint8_t *u1 = (const uint8_t *)s1;
    const uint8_t *u2 = (const uint8_t *)s2;
    while (len > 0) {
        int ch1 = *u1++;
        int ch2 = pgm_read_byte(u2++);
        if (ch1 != ch2)
            return ch1 - ch2;
        --len;
    }
    return 0;
}

void testEval()
{
    static uint8_t const alice_private[66] PROGMEM = {
        0x00, 0x37, 0xAD, 0xE9, 0x31, 0x9A, 0x89, 0xF4,
        0xDA, 0xBD, 0xB3, 0xEF, 0x41, 0x1A, 0xAC, 0xCC,
        0xA5, 0x12, 0x3C, 0x61, 0xAC, 0xAB, 0x57, 0xB5,
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        0x4A, 0x52
    };
    static uint8_t const alice_public[132] PROGMEM = {
        0x00, 0x15, 0x41, 0x7E, 0x84, 0xDB, 0xF2, 0x8C,
        0x0A, 0xD3, 0xC2, 0x78, 0x71, 0x33, 0x49, 0xDC,
        0x7D, 0xF1, 0x53, 0xC8, 0x97, 0xA1, 0x89, 0x1B,
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        0x92, 0x6F, 0x95, 0x82
    };
    static uint8_t const bob_private[66] PROGMEM = {
        0x01, 0x45, 0xBA, 0x99, 0xA8, 0x47, 0xAF, 0x43,
        0x79, 0x3F, 0xDD, 0x0E, 0x87, 0x2E, 0x7C, 0xDF,
        0xA1, 0x6B, 0xE3, 0x0F, 0xDC, 0x78, 0x0F, 0x97,
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        0x5E, 0xB9
    };
    static uint8_t const bob_public[132] PROGMEM = {
        0x00, 0xD0, 0xB3, 0x97, 0x5A, 0xC4, 0xB7, 0x99,
        0xF5, 0xBE, 0xA1, 0x6D, 0x5E, 0x13, 0xE9, 0xAF,
        0x97, 0x1D, 0x5E, 0x9B, 0x98, 0x4C, 0x9F, 0x39,
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        0x7F, 0x0F, 0xC5, 0x6A
    };
    static uint8_t const shared_secret[66] PROGMEM = {
        0x01, 0x14, 0x4C, 0x7D, 0x79, 0xAE, 0x69, 0x56,
        0xBC, 0x8E, 0xDB, 0x8E, 0x7C, 0x78, 0x7C, 0x45,
        0x21, 0xCB, 0x08, 0x6F, 0xA6, 0x44, 0x07, 0xF9,
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        0xDD, 0xEA
    };

    // Evaluate the curve function and check the public keys.
    uint8_t result[132];
    print("Fixed test vectors:\n");
    print("Computing Alice's public key ... \n");
    memcpy_P(alice_f, alice_private, 66);
    unsigned long long start = cpucycles();
    P521::eval(result, alice_f, 0);
    unsigned long long elapsed = cpucycles() - start;
    if (P521_memcmp_P(result, alice_public, 132) == 0) {
        print("ok \n");
    } else {
        print("failed\n");
    }
    print(" (elapsed ");
    printllu(elapsed);
    print(" cycles)\n");
    print("Computing Bob's public key ... ");
    memcpy_P(bob_f, bob_private, 66);
    start = cpucycles();
    P521::eval(result, bob_f, 0);
    elapsed = cpucycles() - start;
    if (P521_memcmp_P(result, bob_public, 132) == 0) {
        print("ok");
    } else {
        print("failed \n");
    }
    print(" (elapsed ");
    printllu(elapsed);
    print(" us)\n");

    // Compute the shared secret from each side.
    print("Computing Alice's shared secret ... ");
    memcpy_P(alice_f, alice_private, 66);
    memcpy_P(bob_k, bob_public, 132);
    memcpy_P(bob_f, shared_secret, 66);
    start = cpucycles();
    P521::eval(result, alice_f, bob_k);
    elapsed = cpucycles() - start;
    if (P521_memcmp_P(result, shared_secret, 66) == 0) {
        print("ok");
    } else {
        print("failed\n");
    }
   print(" (elapsed ");
    printllu(elapsed);
    print(" us)\n");
   print("Computing Bob's shared secret ... ");

    memcpy_P(bob_f, bob_private, 66);
    memcpy_P(alice_k, alice_public, 132);
    memcpy_P(alice_f, shared_secret, 66);
    start = cpucycles();
    P521::eval(result, bob_f, alice_k);
    elapsed = cpucycles() - start;
    if (P521_memcmp_P(result, shared_secret, 66) == 0) {
        print("ok");
    } else {
        print("failed \n");
    }
    print(" (elapsed ");
    printllu(elapsed);
    print(" us)\n");
}